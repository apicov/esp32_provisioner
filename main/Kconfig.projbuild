## main/Kconfig.projbuild
```kconfig
menu "ESP32 Mesh Gateway Configuration"

    menu "WiFi Configuration"
        config WIFI_SSID
            string "WiFi SSID"
            default "myssid"
            help
                SSID (network name) for the gateway to connect to.

        config WIFI_PASSWORD
            string "WiFi Password"
            default "mypassword"
            help
                WiFi password (WPA or WPA2) for the gateway to use.

        config WIFI_MAXIMUM_RETRY
            int "Maximum retry"
            default 5
            help
                Set the Maximum retry to avoid station reconnecting to the AP unlimited when the AP is really inexistent.
    endmenu

    menu "MQTT Configuration"
        config MQTT_BROKER_URI
            string "MQTT Broker URI"
            default "mqtt://192.168.1.100:1883"
            help
                URI of the MQTT broker to connect to.
                Examples:
                - mqtt://192.168.1.100:1883 (local broker)
                - mqtt://test.mosquitto.org:1883 (public test broker)
                - mqtts://broker.example.com:8883 (TLS encrypted)

        config MQTT_CLIENT_ID
            string "MQTT Client ID"
            default "esp32_mesh_gateway"
            help
                Client ID for MQTT connection. Must be unique if multiple gateways connect to same broker.

        config MQTT_USERNAME
            string "MQTT Username"
            default ""
            help
                Username for MQTT authentication (leave empty if not required).

        config MQTT_PASSWORD
            string "MQTT Password"
            default ""
            help
                Password for MQTT authentication (leave empty if not required).

        config MQTT_TOPIC_PREFIX
            string "MQTT Topic Prefix"
            default "esp32"
            help
                Prefix for MQTT topics. Sensor data will be published to <prefix>/sensor/data.
    endmenu

    menu "BLE Mesh Configuration"
        config MESH_UUID_PREFIX_0
            hex "M5Stick UUID Prefix Byte 0"
            default 0xAA
            range 0x00 0xFF
            help
                First byte of M5Stick device UUID prefix for auto-provisioning.

        config MESH_UUID_PREFIX_1
            hex "M5Stick UUID Prefix Byte 1"
            default 0xBB
            range 0x00 0xFF
            help
                Second byte of M5Stick device UUID prefix for auto-provisioning.
    endmenu

endmenu
```

## sdkconfig.defaults
```kconfig
# BLE Mesh Provisioner Configuration
# ====================================
# This file contains the essential menuconfig settings for the provisioner project.
# These settings will be applied when running "idf.py build" on a clean project.

# WiFi Configuration
# ------------------
# Change these to your WiFi credentials
CONFIG_WIFI_SSID="DrPicoNet"
CONFIG_WIFI_PASSWORD="CacaDePerro5000"
CONFIG_WIFI_MAXIMUM_RETRY=5

# MQTT Configuration
# ------------------
# Change broker URI to your MQTT broker
CONFIG_MQTT_BROKER_URI="mqtt://50.116.52.213:2974"
CONFIG_MQTT_CLIENT_ID="esp32_mesh_gateway"
CONFIG_MQTT_USERNAME=""
CONFIG_MQTT_PASSWORD=""
CONFIG_MQTT_TOPIC_PREFIX="esp32"

# BLE Mesh Node UUID Prefix
# --------------------------
# Nodes with UUIDs starting with these bytes will be auto-provisioned
CONFIG_MESH_UUID_PREFIX_0=0xAA
CONFIG_MESH_UUID_PREFIX_1=0xBB

# Bluetooth Configuration
# ------------------------
CONFIG_BT_ENABLED=y
CONFIG_BT_BLUEDROID_ENABLED=y
CONFIG_BT_BLE_ENABLED=y
CONFIG_BT_GATTS_ENABLE=y
CONFIG_BT_GATTC_ENABLE=y

# BLE Mesh Core
# -------------
CONFIG_BLE_MESH=y
CONFIG_BLE_MESH_PROVISIONER=y
CONFIG_BLE_MESH_PB_GATT=y
CONFIG_BLE_MESH_PB_ADV=y
CONFIG_BLE_MESH_GATT_PROXY_CLIENT=y

# BLE Mesh Models
# ---------------
CONFIG_BLE_MESH_CFG_CLI=y
CONFIG_BLE_MESH_GENERIC_ONOFF_CLI=y
CONFIG_BLE_MESH_SENSOR_CLI=y

# BLE Mesh Buffer Configuration
# ------------------------------
# Critical for handling multiple nodes and high-frequency data
CONFIG_BLE_MESH_ADV_BUF_COUNT=60
CONFIG_BLE_MESH_BLE_ADV_BUF_COUNT=3
CONFIG_BLE_MESH_SUPPORT_BLE_ADV=y

# BLE Mesh Provisioner Limits
# ----------------------------
CONFIG_BLE_MESH_PROVISIONER_SUBNET_COUNT=3
CONFIG_BLE_MESH_PROVISIONER_APP_KEY_COUNT=3

# BLE Mesh Network
# ----------------
CONFIG_BLE_MESH_NET_BUF_POOL_USAGE=y
CONFIG_BLE_MESH_NET_BUF_TRACE_LEVEL_WARNING=y

# NVS (Non-Volatile Storage)
# ---------------------------
CONFIG_NVS_ENCRYPTION=n

# FreeRTOS
# --------
CONFIG_FREERTOS_HZ=1000

# ESP32 Main Task
# ---------------
CONFIG_ESP_MAIN_TASK_STACK_SIZE=4096

# Partition Table
# ---------------
CONFIG_PARTITION_TABLE_CUSTOM=n
CONFIG_PARTITION_TABLE_SINGLE_APP_LARGE=y
```
